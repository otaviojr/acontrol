/dts-v1/;
/plugin/;

/ {
    compatible = "brcm,bcm2710","brcm,bcm2709","brcm,bcm2837","brcm,bcm2836";

    fragment@0 {
        target = <&gpio>;
        __overlay__ {
            pcm_pins: pcm_pins {
                brcm,pins = <21>;
                brcm,function = <4>;
            };
        };
    };

    fragment@1 {
      target-path = "/";
      __overlay__ {
        #address-cells = <0x1>;
        #size-cells = <0x1>;

        neopixel@0x3F000000 {
          compatible = "bcm2835-buzzer";

          #address-cells = <0x1>;
          #size-cells = <0x1>;

	        reg = <0x3F000000 0x0      /*0: PHYS BASE ADDRESS*/
                 0x7E000000 0x0      /*1: BUS BASE ADDRESS*/
                 0x00203000 0x100    /*2: PCM BASE ADDRESS*/
                 0x00101098 0x08>;   /*3: PCMCTL BASE ADDRESS OFFSSET*/

          reg-names = "buzzer-phys-addr","buzzer-bus-addr","buzzer-pcm", "buzzer-pcmctl-cm";

          pinctrl-0 = <&pcm_pins>;
          pinctrl-names = "default";

          dmas = <&dma 2>;
          dma-names = "buzzer-pcm-dma";
        };
      };
    };
};
